## CMakeLists.txt
```
cmake_minimum_required(VERSION 3.20.0)

find_package(Zephyr REQUIRED HINTS $ENV{ZEPHYR_BASE})
project(lab08_message_queue_host)

target_sources(app PRIVATE src/main.c)
target_include_directories(app PRIVATE include)
```

## prj.conf
```kconfig
CONFIG_MBOX=y
CONFIG_LOG=y
CONFIG_LOG_DEFAULT_LEVEL=3
CONFIG_PRINTK=y
```

## src/main.c
```c
/*
 * Lab 08: Multi-Type Message Queue (HOST, M55)
 * Sends several LED pattern commands back-to-back (no delay in between)
 * to exercise M4's queuing behavior.
 */

#include <zephyr/kernel.h>
#include <zephyr/drivers/mbox.h>
#include <zephyr/logging/log.h>
#include "ipc_common.h"

LOG_MODULE_REGISTER(lab08_host, CONFIG_LOG_DEFAULT_LEVEL);

static struct mbox_dt_spec tx_channel;

static void send_pattern(uint32_t pattern_id, uint32_t repeat)
{
	struct ipc_pattern_msg msg = {.pattern_id = pattern_id, .repeat = repeat};
	struct mbox_msg mbox_msg = {.data = &msg, .size = sizeof(msg)};

	mbox_send_dt(&tx_channel, &mbox_msg);
	LOG_INF("queued pattern_id=%u repeat=%u", pattern_id, repeat);
}

int main(void)
{
	LOG_INF("Lab08 Multi-Type Message Queue HOST - %s", CONFIG_BOARD_TARGET);

	tx_channel = (struct mbox_dt_spec)MBOX_DT_SPEC_GET(DT_PATH(mbox_consumer), tx);

	while (1) {
		/* Send all 4 back-to-back -> they queue up on M4 while it's busy running them */
		send_pattern(PATTERN_BLINK_LED0, 3);
		send_pattern(PATTERN_BLINK_LED1, 3);
		send_pattern(PATTERN_ALTERNATE, 3);
		send_pattern(PATTERN_BOTH_FLASH, 2);

		k_msleep(6000);
	}

	return 0;
}
```

## include/ipc_common.h
```c
#ifndef LAB08_IPC_COMMON_H
#define LAB08_IPC_COMMON_H

#include <stdint.h>

enum ipc_pattern_id {
	PATTERN_BLINK_LED0  = 1,
	PATTERN_BLINK_LED1  = 2,
	PATTERN_ALTERNATE   = 3,
	PATTERN_BOTH_FLASH  = 4,
};

struct ipc_pattern_msg {
	uint32_t pattern_id; /* enum ipc_pattern_id */
	uint32_t repeat;     /* number of times to repeat the pattern */
};

#endif
```
